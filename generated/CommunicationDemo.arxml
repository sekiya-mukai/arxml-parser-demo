AUTOSAR XML
package /CommunicationPackage
  sender receiver interface CounterInterface
